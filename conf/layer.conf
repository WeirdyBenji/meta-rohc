## conf/layer.conf
```bitbake
# We have a conf and classes directory, add to BBPATH
BBPATH .= ":${LAYERDIR}"

# We have recipes-* directories, add to BBFILES
BBFILES += "${LAYERDIR}/recipes-*/*/*.bb \
            ${LAYERDIR}/recipes-*/*/*.bbappend"

BBFILE_COLLECTIONS += "meta-thales"
BBFILE_PATTERN_meta-thales = "^${LAYERDIR}/"
BBFILE_PRIORITY_meta-thales = "6"

LAYERDEPENDS_meta-thales = "core"
LAYERSERIES_COMPAT_meta-thales = "mickledore nanbield"
```
